## Config.in
```kconfig
source "$BR2_EXTERNAL_REDWIRE_PACKAGES_PATH/package/redwire-base/Config.in"
source "$BR2_EXTERNAL_REDWIRE_PACKAGES_PATH/package/redwire-linux-mods/Config.in"
source "$BR2_EXTERNAL_REDWIRE_PACKAGES_PATH/package/redwire-wireguard/Config.in"
```

## package/additional-patches/Config.in
```kconfig
menu "Buildroot patches"

config BR2_PACKAGE_REDWIRE_LABS_BUILDROOT_PATCHES_IN_SYSTEM
	bool "Nerves system directory"
	help
	  Buildroot packages are located in the Nerves system directory:
	  $NERVES_DEFCONFIG_DIR/patches/buildroot

config BR2_PACKAGE_REDWIRE_LABS_BUILDROOT_PATCHES_PATH
	string "Additional patches directories"
	help
	  Directories containing additional patches to apply to buildroot,
	  space separated.

endmenu
```

## package/base/Config.in
```kconfig
config BR2_PACKAGE_REDWIRE_LABS_BASE
	bool "Base packages"
	default y
	select BR2_PACKAGE_IPTABLES
	select BR2_PACKAGE_IPROUTE2
	select BR2_PACKAGE_NET_TOOLS
	help
	  Standard packages included with a Redwire Labs Nerves system.
```

## package/linux-helpers/Config.in
```kconfig
config BR2_PACKAGE_REDWIRE_LABS_LINUX_HELPERS
	bool "Linux helpers"
	help
	  Redwire Labs config helpers for Linux.
```

## package/linux-helpers/Kconfig
```kconfig
menu "Redwire Labs"

config REDWIRE_LABS_BASE
	bool "Base features"
	default y
	select WIREGUARD
	help
	  Standard features included with a Redwire Labs Nerves system.

endmenu
```

## package/redwire-labs-base/Config.in
```kconfig
config BR2_PACKAGE_REDWIRE_LABS_BASE
    bool "redwire-labs-base"
    select BR2_PACKAGE_IPTABLES
    help
      Standard packages included with a Redwire Labs Nerves system.
```

## package/redwire-linux-mods/Config.in
```kconfig
config BR2_PACKAGE_REDWIRE_LABS_LINUX_MODS
	bool "Linux mods"
	help
	  Redwire Labs modifications and config helpers for Linux.
```

## package/redwire-linux-mods/Kconfig
```kconfig
menu "Redwire Labs"

config REDWIRE_LABS_BASE
	bool "Base built-ins"
	default y
	help
	  Standard built-in features included with a Redwire Labs Nerves system.

	  https://www.redwirelabs.com

config REDWIRE_LABS_BASE_MODULES
	tristate "Base modules"
	default m
	select WIREGUARD
	help
	  Standard kernel modules included with a Redwire Labs Nerves system.
	  ONLY set this to M or N.

	  https://www.redwirelabs.com

endmenu
```

## package/redwire-wireguard/Config.in
```kconfig
config BR2_PACKAGE_REDWIRE_LABS_WIREGUARD
	bool "Wireguard"
	select BR2_PACKAGE_WIREGUARD_TOOLS
	help
	  Wireguard
```

## package/vintage-net-wifi/Config.in
```kconfig
config BR2_PACKAGE_REDWIRE_LABS_VINTAGE_NET_WIFI
	bool "VintageNet Wi-Fi"
	select BR2_PACKAGE_WPA_SUPPLICANT
	select BR2_PACKAGE_WPA_SUPPLICANT_WPA3
	select BR2_PACKAGE_WPA_SUPPLICANT_HOTSPOT
	help
	  Compatibility for VintageNet Wi-Fi networking.

	  https://github.com/nerves-networking/vintage_net_wifi
```
